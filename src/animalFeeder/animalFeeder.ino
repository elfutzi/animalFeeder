#include <ESP8266WiFi.h>
#include "Adafruit_MQTT.h"
#include "Adafruit_MQTT_Client.h"
#include <Servo.h>
#include "lcdgfx.h"
#include <CheapStepper.h>
#include <WiFiUdp.h>
#include <NTPClient.h>
#include <Time.h>
#include <TimeAlarms.h>

#define WIFI_SSID "WLAN-173336"
#define WIFI_PASS "4969110953683277"

#define MQTT_SERV "io.adafruit.com"
#define MQTT_PORT 1883
#define MQTT_NAME "elfutzi"
#define MQTT_PASS "fda7dcab25be419fbf584324f16e3fbd"

//servo1 positions
const uint16_t clapClosedPositionValue = 8;
const uint16_t clapOpenPositionValue = 100;

//servo2 positions
const uint16_t stirStartPositionValue = 0;
const uint16_t stirEndPositionValue = 43;

//delays
const uint16_t connectedDelay = 4000;
const uint16_t startDelay = 6000;
const uint16_t displayRefreshDelay = 500;
const uint16_t clapDelay = 500;
const uint16_t waitingDelay = 1500;
const uint16_t openClapDelay = 2000;
const uint16_t feedingDelay = 3000;
const uint16_t enjoyDelay = 6000;
const uint16_t goodbyeDelay = 8000;
const uint16_t abortDelay = 1500;
const uint16_t feedPause = 100;
const uint16_t processPacketsDelay = 200;
const uint16_t retractionDelay = 100;

//stepper
const uint16_t turnarroundsBeforClose = 1;
const uint16_t stepsTurnarround = 1300;
const uint16_t stepsRetraction = 400;
const uint16_t stepsPerGramm = 900;
uint16_t grammsStandardPortion = 5;
bool moveClockwise = true;
const uint16_t stepperRPM = 16;

//display
const int displayLineDistance = 8;

//NTP client
WiFiUDP ntpUDP;

NTPClient timeClient(ntpUDP, "europe.pool.ntp.org", 3600, 60000);

int led = D7;

WiFiClient client;
Servo servo1;
Servo servo2;

CheapStepper stepper (14, 12, 13, 15);

Adafruit_MQTT_Client mqtt(&client, MQTT_SERV, MQTT_PORT, MQTT_NAME, MQTT_PASS);

Adafruit_MQTT_Subscribe feed = Adafruit_MQTT_Subscribe(&mqtt, MQTT_NAME "/f/FEED");
Adafruit_MQTT_Subscribe feedgramms = Adafruit_MQTT_Subscribe(&mqtt, MQTT_NAME "/f/FEEDGRAMM");
Adafruit_MQTT_Subscribe feedtimer = Adafruit_MQTT_Subscribe(&mqtt, MQTT_NAME "/f/FEEDTIMER");
Adafruit_MQTT_Subscribe setgramms = Adafruit_MQTT_Subscribe(&mqtt, MQTT_NAME "/f/SETGRAMM");
Adafruit_MQTT_Subscribe getgramms = Adafruit_MQTT_Subscribe(&mqtt, MQTT_NAME "/f/GETGRAMM");
Adafruit_MQTT_Subscribe showalarms = Adafruit_MQTT_Subscribe(&mqtt, MQTT_NAME "/f/SHOWALARMS");
Adafruit_MQTT_Subscribe deletealarm = Adafruit_MQTT_Subscribe(&mqtt, MQTT_NAME "/f/DELETEALARM");

Adafruit_MQTT_Publish statuslog = Adafruit_MQTT_Publish(&mqtt, MQTT_NAME "/f/STATUSLOG");

DisplaySSD1306_128x64_I2C display(-1);

//picture connecting to WiFi
const uint8_t pictureConnecting [] PROGMEM = {
  0x00, 0x00, 0x00, 0x00, 0x00, 0x00, 0x00, 0x00, 0x00, 0x00, 0x00, 0x00, 0x00, 0x00, 0x00, 0x00,
  0x00, 0x00, 0x00, 0x00, 0x00, 0x00, 0x00, 0x02, 0x00, 0x00, 0x30, 0x93, 0xbc, 0x00, 0x00, 0x00,
  0x00, 0x00, 0x00, 0x00, 0x00, 0x00, 0x20, 0x00, 0x00, 0x02, 0x20, 0x13, 0x04, 0x00, 0x00, 0x00,
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  0x00, 0x00, 0x00, 0x00, 0x00, 0x00, 0x00, 0x00, 0x00, 0x00, 0x00, 0x00, 0x00, 0x00, 0x00, 0x00
};

//picture connecting to WiFi
const uint8_t pictureConnected [] PROGMEM = {
  0x00, 0x00, 0x00, 0x00, 0x00, 0x00, 0x00, 0x00, 0x00, 0x00, 0x00, 0x00, 0x00, 0x00, 0x00, 0x00,
  0x00, 0x00, 0x00, 0x00, 0x00, 0x00, 0x00, 0x00, 0x00, 0x00, 0x00, 0x00, 0x00, 0x00, 0x00, 0x00,
  0x00, 0x00, 0x00, 0x00, 0xc0, 0x01, 0x00, 0x00, 0x00, 0x00, 0x20, 0x01, 0x00, 0x00, 0x00, 0x00,
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  0x00, 0x00, 0x00, 0x00, 0x00, 0x00, 0x00, 0x00, 0x00, 0x00, 0x00, 0x00, 0x00, 0x00, 0x00, 0x00
};

//picture can start
const uint8_t pictureStart [] PROGMEM = {
  0x00, 0x00, 0x00, 0x00, 0x00, 0x00, 0x00, 0x00, 0x00, 0x00, 0x00, 0x00, 0x00, 0x00, 0x00, 0x00,
  0x00, 0x00, 0x00, 0x00, 0x00, 0x00, 0x00, 0x00, 0x00, 0x00, 0x00, 0x00, 0x00, 0x00, 0x00, 0x00,
  0x00, 0x00, 0xe0, 0x01, 0x00, 0x12, 0x00, 0x00, 0x00, 0x00, 0x00, 0x00, 0x00, 0x00, 0x00, 0x00,
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  0x00, 0x00, 0x00, 0xc0, 0x00, 0x03, 0xf8, 0x1f, 0x38, 0x1c, 0x80, 0x01, 0x00, 0x00, 0x00, 0x00
};

//picture cat waiting
const uint8_t pictureCatWaitintg [] PROGMEM = {
  0x00, 0x00, 0x00, 0x00, 0x00, 0x00, 0x00, 0x00, 0x00, 0x00, 0x00, 0x00, 0x00, 0x00, 0x00, 0x00,
  0x00, 0x00, 0x00, 0x00, 0x00, 0x00, 0x00, 0x00, 0x00, 0x00, 0x00, 0x00, 0x00, 0x00, 0x00, 0x00,
  0x00, 0x00, 0x10, 0x40, 0x04, 0xf9, 0x08, 0x7c, 0x1c, 0xe7, 0xc0, 0x71, 0xa2, 0x92, 0x03, 0x00,
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  0x00, 0x00, 0x00, 0x00, 0x00, 0x00, 0x00, 0x8c, 0xff, 0x00, 0x00, 0x00, 0x00, 0x00, 0x00, 0x00
};

//picture abort
const uint8_t pictureAbort [] PROGMEM = {
  0x00, 0x00, 0x00, 0x00, 0x00, 0x00, 0x00, 0x00, 0x00, 0x00, 0x00, 0x00, 0x00, 0x00, 0x00, 0x00,
  0x00, 0x00, 0x00, 0x00, 0x00, 0x00, 0xc2, 0x71, 0xce, 0x47, 0x00, 0x00, 0x00, 0x00, 0x00, 0x00,
  0x00, 0x00, 0x00, 0x00, 0x00, 0x00, 0x45, 0x8a, 0x12, 0x41, 0x00, 0x00, 0x00, 0x00, 0x00, 0x00,
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  0x00, 0x00, 0x00, 0x00, 0x00, 0x00, 0x00, 0x00, 0x00, 0x00, 0x00, 0x00, 0x00, 0x00, 0x00, 0x00
};

//picture enjoy your meal
const uint8_t pictureEnjoy [] PROGMEM = {
  0x00, 0x00, 0x00, 0x00, 0x00, 0x00, 0x00, 0x00, 0x00, 0x00, 0x00, 0x00, 0x00, 0x00, 0x00, 0x00,
  0x00, 0x00, 0x00, 0x78, 0x40, 0x00, 0x00, 0x00, 0x00, 0x00, 0x00, 0x00, 0x24, 0x00, 0x00, 0x00,
  0x00, 0x00, 0x00, 0x08, 0x00, 0x00, 0x00, 0x00, 0x00, 0x00, 0x00, 0x00, 0x24, 0x00, 0x00, 0x00,
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  0x00, 0x00, 0x00, 0x00, 0x00, 0x00, 0x00, 0x00, 0xff, 0x03, 0x00, 0x00, 0x00, 0x00, 0x00, 0x00
};

//picture goodbye
const uint8_t pictureGoodbye [] PROGMEM = {
  0x00, 0x00, 0x00, 0x00, 0x00, 0x00, 0x00, 0x00, 0x00, 0x00, 0x00, 0x00, 0x00, 0x00, 0x00, 0x00,
  0x00, 0x00, 0x00, 0x00, 0x00, 0x0f, 0x00, 0x20, 0x01, 0x00, 0x02, 0x00, 0x00, 0x00, 0x00, 0x00,
  0x00, 0x00, 0x00, 0x00, 0x80, 0x09, 0x00, 0x20, 0x01, 0x00, 0x02, 0x00, 0x00, 0x00, 0x00, 0x00,
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  0x00, 0x00, 0x00, 0x00, 0x00, 0x00, 0x00, 0x00, 0x00, 0x00, 0x00, 0x00, 0x00, 0x00, 0x00, 0x00
};

#define MAX_ALARM_COUNT 7
#define INVALID_HOUR 255
AlarmID_t alarms_ids[MAX_ALARM_COUNT] = {dtINVALID_ALARM_ID, dtINVALID_ALARM_ID, dtINVALID_ALARM_ID, dtINVALID_ALARM_ID, dtINVALID_ALARM_ID, dtINVALID_ALARM_ID, dtINVALID_ALARM_ID};
timeDayOfWeek_t alarms_weekdays[MAX_ALARM_COUNT] = {dowInvalid, dowInvalid, dowInvalid, dowInvalid, dowInvalid, dowInvalid, dowInvalid};
int alarms_hours[MAX_ALARM_COUNT] = {INVALID_HOUR, INVALID_HOUR, INVALID_HOUR, INVALID_HOUR, INVALID_HOUR, INVALID_HOUR, INVALID_HOUR};

int nextAlarmsIndex = -1;
int currentSetAlarmsAmount = 0;

void setup()
{
  //setup display
  display.begin();
  display.fill(0x00);
  display.drawXBitmap(0, 0, 128, 64, pictureConnecting);

  //setup serial connection
  Serial.begin(9600);

  //stepper setup
  stepper.setRpm(stepperRPM);

  //Connect to WiFi
  Serial.print("\n\nConnecting Wifi>");
  WiFi.begin(WIFI_SSID, WIFI_PASS);

  while (WiFi.status() != WL_CONNECTED)
  {
    Serial.print(">");
    delay(50);
  }

  Serial.println("OK!");
  display.drawXBitmap(0, 0, 128, 64, pictureConnected);

  //Subscribe to the feed topics
  mqtt.subscribe(&feed);
  mqtt.subscribe(&feedgramms);
  mqtt.subscribe(&feedtimer);
  mqtt.subscribe(&setgramms);
  mqtt.subscribe(&getgramms);
  mqtt.subscribe(&showalarms);
  mqtt.subscribe(&deletealarm);

  delay(connectedDelay);
  display.drawXBitmap(0, 0, 128, 64, pictureStart);
  delay(startDelay);
  display.fill(0x00);

  //ntp client
  timeClient.begin();
  //time lib
  setSyncProvider(syncWithNTP);
  setSyncInterval(1);

  pinMode(LED_BUILTIN, OUTPUT);
  digitalWrite(LED_BUILTIN, HIGH);
  pinMode(led, OUTPUT);
  digitalWrite(led, HIGH);
  detachStepper();
}

void loop()
{
  timeClient.update();
  Alarm.delay(1);
  now();
  //Connect/Reconnect to MQTT
  MQTT_connect();

  //Read from our subscription queue until we run out, or
  //wait up to 5 seconds for subscription to update
  Adafruit_MQTT_Subscribe * subscription;
  while ((subscription = mqtt.readSubscription(5000)))
  {
    Serial.print("");
    //If we're in here, a subscription updated...
    if (subscription == &feed)
    {
      //Print the new value to the serial monitor
      Serial.print("feed: ");
      Serial.println((char*) feed.lastread);

      //If the new value is  "ONCE", feed default amount of food.
      //Otherwise, close clap and do nothing.
      if (!strcmp((char*) feed.lastread, "ONCE"))
      {
        feedStandardPortion();
        
        //logging
        String logString = String("One standard portion fed with ");
        logString += grammsStandardPortion;
        logString += " gramms.";
        statuslog.publish(logString.c_str());
      }
      else if (!strcmp((char*) feed.lastread, "ABORT"))
      {
        //digitalWrite(led, LOW);
        Serial.println("Füttern abbrechen");
        drawAbort();
        Alarm.delay(abortDelay);
        closeClap();
        Serial.println("Füttern erfolgreich abgebrochen");

        //logging
        String logString = String("Feeding aborted!");
        statuslog.publish(logString.c_str());
      }
      else
      {
        // publish ERROR
      }
    }
    else if (subscription == &feedgramms)
    {
      //command values
      uint16_t requestedGramms = atoi((char *)feedgramms.lastread);  // convert to a number
      feedGrammsPortion(requestedGramms);

      //logging
      String logString = String("Custom portion fed with ");
      logString += requestedGramms;
      logString += " gramms.";
      statuslog.publish(logString.c_str());
    }
    else if (subscription == &setgramms)
    {
      grammsStandardPortion = atoi((char *)setgramms.lastread);  // convert to a number
      Serial.println("Gewicht gesetzt!");
      Serial.print(grammsStandardPortion);
      Serial.println(" Gramm");
      // show on display
      display.setFixedFont( ssd1306xled_font6x8 );
      display.clear();
      display.printFixed(0,  8, "standard portion set to:", STYLE_NORMAL);
      String gramms = String(grammsStandardPortion);
      const char* grammsChar = gramms.c_str();
      display.printFixed(0, 32, grammsChar, STYLE_BOLD);
      display.printFixed(0, 46, "gramms", STYLE_NORMAL);
      lcd_delay(15000);
      display.clear();
      
      //logging
      String logString = String("Set weight of the standard portion to ");
      logString += grammsStandardPortion;
      logString += " gramms.";
      statuslog.publish(logString.c_str());
    }
    else if (subscription == &getgramms)
    {
      Serial.println("Das Gewicht der Standardportion lautet ");
      Serial.print(grammsStandardPortion);
      Serial.println(" Gramm");
      // show on display
      display.setFixedFont( ssd1306xled_font6x8 );
      display.clear();
      display.printFixed(0,  8, "standard portion is:", STYLE_NORMAL);
      String gramms = String(grammsStandardPortion);
      const char* grammsChar = gramms.c_str();
      display.printFixed(0, 32, grammsChar, STYLE_BOLD);
      display.printFixed(0, 46, "gramms", STYLE_NORMAL);
      lcd_delay(15000);
      display.clear();

      //logging
      String logString = String("Currently set weight of a standard portion is ");
      logString += grammsStandardPortion;
      logString += " gramms.";
      statuslog.publish(logString.c_str());
    }
    else if (subscription == &showalarms)
    {
      Serial.println("Zeige alle Alarme:");
      printAlarmsSerial();
      printAlarmsDisplay();
      printAlarmsMQTTLog();
    }
    else if (subscription == &feedtimer)
    {
      //command values
      char* inputTimerFeed = (char *)feedtimer.lastread;
      char* dayInput;
      char* houreInput;
      dayInput = strtok (inputTimerFeed, ";");
      if (dayInput != NULL)
      {
        houreInput = strtok (NULL, ";");
      }

      if (currentSetAlarmsAmount < MAX_ALARM_COUNT) {

        
        //save alarm
        nextAlarmsIndex = findNextAlarmsIndex();
        timeDayOfWeek_t weekdayEnum = mapWeekdayCharEnum(dayInput);
        alarms_ids[nextAlarmsIndex] = Alarm.alarmRepeat(weekdayEnum, atoi(houreInput), 00, 00, feedAlarm); // TODO Test wieder wegnehmen
        alarms_weekdays[nextAlarmsIndex] = weekdayEnum;
        alarms_hours[nextAlarmsIndex] = atoi(houreInput);
        currentSetAlarmsAmount++;


        Serial.println("Alarm gesetzt! Neuer Index:");
        Serial.println(nextAlarmsIndex);

        // show on display
        display.setFixedFont( ssd1306xled_font6x8 );
        display.clear();
        display.printFixed(0, 8, "set timer for:", STYLE_NORMAL);
        display.printFixed(0, 32, dayInput, STYLE_BOLD);
        display.printFixed(0, 46, houreInput, STYLE_NORMAL);
        display.printFixed(30, 46, "UHR", STYLE_NORMAL);
        lcd_delay(8000);
        display.clear();

        //logging
        String logString = String("Alarm set:  ");
        logString += dayInput;
        logString += " ";
        logString += houreInput;
        logString += " ó clock.";
        statuslog.publish(logString.c_str());
      }
      else
      {
        Serial.println("Zu viele Alarme gesetzt!");
        // show on display
        display.setFixedFont( ssd1306xled_font6x8 );
        display.clear();
        display.printFixed(0, 32, "Too much alarms. No further possible.", STYLE_BOLD);
        lcd_delay(8000);
        display.clear();

        //logging
        String logString = String("Too much alarms. No further possible.");
        statuslog.publish(logString.c_str());
      }
    }
    else if (subscription == &deletealarm)
    {
      //command values
      uint16_t alarmId = atoi((char *)deletealarm.lastread);  // convert to a number
      deleteAlarm(alarmId);
      display.printFixed(0, 32, "Alarm deleted.", STYLE_BOLD);
      lcd_delay(8000);
      display.clear();

      //logging
      String logString = String("Alarm with ID ");
      logString += alarmId;
      logString += " deleted.";
      statuslog.publish(logString.c_str());
    }
    else
    {
      // publish ERROR
    }
  }
  //  if (!mqtt.ping())
  //  {
  //    mqtt.disconnect();
  //  }
}


void MQTT_connect()
{

  //  // Stop if already connected
  if (mqtt.connected() && mqtt.ping())
  {
    //    mqtt.disconnect();
    return;
  }

  int8_t ret;

  mqtt.disconnect();

  Serial.print("Connecting to MQTT... ");
  uint8_t retries = 3;
  while ((ret = mqtt.connect()) != 0) // connect will return 0 for connected
  {
    Serial.println(mqtt.connectErrorString(ret));
    Serial.println("Retrying MQTT connection in 5 seconds...");
    mqtt.disconnect();
    delay(5000);  // wait 5 seconds
    retries--;
    if (retries == 0)
    {
      ESP.reset();
    }
  }
  Serial.println("MQTT Connected!");
}

void openClap() {
  setupServo1();
  servo1.write(clapOpenPositionValue);
  delay(clapDelay);
  detachServo1();
}

void closeClap() {
  setupServo1();
  servo1.write(clapClosedPositionValue);
  delay(clapDelay);
  detachServo1();
}

void drawWaiting() {
  display.drawXBitmap(0, 0, 128, 64, pictureCatWaitintg);
  lcd_delay(displayRefreshDelay);
}

void drawAbort() {
  display.drawXBitmap(0, 0, 128, 64, pictureAbort);
  lcd_delay(displayRefreshDelay);
}

void drawEnjoy() {
  display.drawXBitmap(0, 0, 128, 64, pictureEnjoy);
  lcd_delay(displayRefreshDelay);
}

void drawGoodbye() {
  display.drawXBitmap(0, 0, 128, 64, pictureGoodbye);
  lcd_delay(displayRefreshDelay);
}

void feedStandardPortion() {
  Serial.println("füttere die Standardportion");
  feedPrepare();
  feedOneTurnarround(((grammsStandardPortion * stepsPerGramm) / stepsTurnarround) + 1);
  feedFinish();
}

void feedGrammsPortion(uint16_t gramms) {
  Serial.println("füttere in Gramm");
  feedPrepare();
  feedOneTurnarround(((gramms * stepsPerGramm) / stepsTurnarround) + 1);
  feedFinish();
}

void feedOneTurnarround(int countTurnarrounds) {
  setupServo2();
  setupStepper();
  for (uint16_t i = 0; i < countTurnarrounds; i++) {
    servo2.write(stirEndPositionValue);
    stepper.move(moveClockwise, stepsTurnarround);
    delay(retractionDelay);
    servo2.write(stirStartPositionValue);
    stepper.move(!moveClockwise, stepsRetraction);
    mqtt.processPackets(processPacketsDelay);
    delay(feedPause);
  }
  void stop();
  detachServo2();
  detachStepper();
}

void retractBeforeClose() {
  setupStepper();
  for (uint16_t j = 0; j < turnarroundsBeforClose; j++) {
    stepper.move(!moveClockwise, stepsTurnarround);
    mqtt.processPackets(processPacketsDelay);
    delay(feedPause);
  }
  void stop();
  detachStepper();
}

void feedPrepare() {
  //start feeding
  drawWaiting();
  delay(waitingDelay);
  openClap();
  delay(openClapDelay);
}

void feedFinish() {
  //finish actions
  retractBeforeClose();
  drawEnjoy();
  closeClap();
  delay(enjoyDelay);
  Serial.println("Erfolgreich gefüttert");
  drawGoodbye();
  delay(goodbyeDelay);
  display.fill(0x00);
}

time_t syncWithNTP() {
  unsigned long epochTime = 0;
  epochTime = timeClient.getEpochTime();
  return epochTime;
}

int findNextAlarmsIndex() {
  for (int i = 0; i < MAX_ALARM_COUNT; i++)
  {
    if (alarms_ids[i] == dtINVALID_ALARM_ID)
    {
      return i;
    }
  }
  return -1;
}

void printAlarmsSerial() {
  for (int i = 0; i < MAX_ALARM_COUNT; i++)
  {
    if (alarms_ids[i] == dtINVALID_ALARM_ID) {
      Serial.println("leer");
    }
    else
    {
      time_t alarmValue = Alarm.read(alarms_ids[i]);
      char weekdayChar[12];
      mapWeekdayEnumChar(alarms_weekdays[i], weekdayChar);
      Serial.print(alarms_ids[i]);
      Serial.print(": ");
      Serial.print(weekdayChar);
      Serial.print(" ");
      Serial.print(alarms_hours[i]);
      Serial.print(" ");
      Serial.print("Uhr");
      Serial.println(" ");
    }
  }
}

void printAlarmsDisplay() {
  display.setFixedFont( ssd1306xled_font6x8 );
  display.clear();

  for (int i = 0; i < MAX_ALARM_COUNT; i++)
  {
    if (alarms_ids[i] == dtINVALID_ALARM_ID) {
      display.printFixed(0, 5 + (displayLineDistance * i), "leer", STYLE_NORMAL);
    }
    else
    {
      String alarmID = String(alarms_ids[i]);
      const char* alarmIDChar = alarmID.c_str();
      char weekdayChar[12];
      mapWeekdayEnumChar(alarms_weekdays[i], weekdayChar);
      String hoursCharsString = String(alarms_hours[i]);
      const char* hourChars = hoursCharsString.c_str();
      display.printFixed(0, 5 + (displayLineDistance * i), alarmIDChar, STYLE_NORMAL);
      display.printFixed(10, 5 + (displayLineDistance * i), ":", STYLE_NORMAL);
      display.printFixed(17, 5 + (displayLineDistance * i), weekdayChar, STYLE_NORMAL);
      display.printFixed(80, 5 + (displayLineDistance * i), hourChars, STYLE_NORMAL);
      display.printFixed(95, 5 + (displayLineDistance * i), "Uhr", STYLE_NORMAL);
    }
  }
  lcd_delay(8000);
  display.clear();
}

void printAlarmsMQTTLog() {

  //logging
  String logString = String("All alarms: ");
  for (int i = 0; i < MAX_ALARM_COUNT; i++)
  {
    if (alarms_ids[i] == dtINVALID_ALARM_ID) {
      Serial.println("leer");
    }
    else
    {
      time_t alarmValue = Alarm.read(alarms_ids[i]);
      char weekdayChar[12];
      mapWeekdayEnumChar(alarms_weekdays[i], weekdayChar);
      logString += "[ ";
      logString += alarms_ids[i];
      logString += ": ";
      logString += weekdayChar;
      logString += " ";
      logString += alarms_hours[i];
      logString += "] ";
    }
  }
  statuslog.publish(logString.c_str());   
}

timeDayOfWeek_t mapWeekdayCharEnum(char* weekdayChars) {
  timeDayOfWeek_t weekdayEnum = dowInvalid;
  if (strcmp(weekdayChars, "Montag")==0)
  {
    weekdayEnum = dowMonday;
  }
  else if (strcmp(weekdayChars, "Dienstag")==0)
  {
    weekdayEnum = dowTuesday;
  }
  else if (strcmp(weekdayChars, "Mittwoch")==0)
  {
    weekdayEnum = dowWednesday;
  }
  else if (strcmp(weekdayChars, "Donnerstag")==0)
  {
    weekdayEnum = dowThursday;
  }
  else if (strcmp(weekdayChars, "Freitag")==0)
  {
    weekdayEnum = dowFriday;
  }
  else if (strcmp(weekdayChars, "Samstag")==0)
  {
    weekdayEnum = dowSaturday;
  }
  else if (strcmp(weekdayChars, "Sonntag")==0)
  {
    weekdayEnum = dowSunday;
  }
  return weekdayEnum;
}

void mapWeekdayEnumChar(int enumIndex, char* weekdayChar)
{
  switch (enumIndex)
  {
    case 0:
      strcpy(weekdayChar, "invalid");
      break;
    case 1:
      strcpy(weekdayChar, "Sonntag");
      break;
    case 2:
      strcpy(weekdayChar, "Montag");
      break;
    case 3:
      strcpy(weekdayChar, "Dienstag");
      break;
    case 4:
      strcpy(weekdayChar, "Mittwoch");
      break;
    case 5:
      strcpy(weekdayChar, "Donnerstag");
      break;
    case 6:
      strcpy(weekdayChar, "Freitag");
      break;
    case 7:
      strcpy(weekdayChar, "Samstag");
      break;
    default:
      strcpy(weekdayChar, "invalid");
      break;
  }
}

void deleteAlarm(int alarmId)
{
  for (int i = 0; i < MAX_ALARM_COUNT; i++)
  {
    if (alarms_ids[i] == alarmId) {
      Alarm.free(alarms_ids[i]);
      alarms_ids[i] = dtINVALID_ALARM_ID;
      alarms_weekdays[i] = dowInvalid;
      alarms_hours[i] = INVALID_HOUR;
      

      Serial.print("Alarm Nr. ");
      Serial.print(i);
      Serial.println(" gelöscht");
      return;
    }
  }
}

void setupServo1() 
{
  servo1.attach(2); //D4
  servo1.write(0);
  delay (200);  
}

void setupServo2() 
{
  servo2.attach(3); //D9
  servo2.write(0);
  delay (200);  
}

void detachServo1() 
{
  servo1.detach();
}

void detachServo2()
{
  servo2.detach();
}

void setupStepper()
{
  digitalWrite(14,HIGH);
  digitalWrite(12,HIGH);
  digitalWrite(13,HIGH);
  digitalWrite(15,HIGH);   
}

void detachStepper() 
{
  digitalWrite(14,LOW);
  digitalWrite(12,LOW);
  digitalWrite(13,LOW);
  digitalWrite(15,LOW);   
}

void feedAlarm() {
  feedStandardPortion();

  //logging
  String logString = String("Fed triggered by Alarm: ");
  logString += grammsStandardPortion;
  logString += " gramms.";
  statuslog.publish(logString.c_str());
}
